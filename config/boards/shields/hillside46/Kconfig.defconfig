## config/boards/shields/hillside46/Kconfig.defconfig
```kconfig
# Copyright (c) 2021-2022 The ZMK Contributors
# SPDX-License-Identifier: MIT

if SHIELD_HILLSIDE46_LEFT

config ZMK_KEYBOARD_NAME
    default "Hillside46"

config ZMK_SPLIT_BLE_ROLE_CENTRAL
    default y

endif

if SHIELD_HILLSIDE46_LEFT || SHIELD_HILLSIDE46_RIGHT

config ZMK_SPLIT
    default y

endif
```

## config/boards/shields/hillside46/Kconfig.shield
```kconfig
# Copyright (c) 2021-2022 The ZMK Contributors
# SPDX-License-Identifier: MIT

config SHIELD_HILLSIDE46_LEFT
    def_bool $(shields_list_contains,hillside46_left)

config SHIELD_HILLSIDE46_RIGHT
    def_bool $(shields_list_contains,hillside46_right)
```

## config/boards/shields/hillside52/Kconfig.defconfig
```kconfig
# Copyright (c) 2021-2022 The ZMK Contributors
# SPDX-License-Identifier: MIT

if SHIELD_HILLSIDE52_LEFT

config ZMK_KEYBOARD_NAME
    default "Hillside52"

config ZMK_SPLIT_BLE_ROLE_CENTRAL
    default y

endif

if SHIELD_HILLSIDE52_LEFT || SHIELD_HILLSIDE52_RIGHT

config ZMK_SPLIT
    default y

endif
```

## config/boards/shields/hillside52/Kconfig.shield
```kconfig
# Copyright (c) 2021 The ZMK Contributors
# SPDX-License-Identifier: MIT

config SHIELD_HILLSIDE48_LEFT
    def_bool $(shields_list_contains,hillside48_left)

config SHIELD_HILLSIDE48_RIGHT
    def_bool $(shields_list_contains,hillside48_right)
```
